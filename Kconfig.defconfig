## Kconfig.defconfig
```kconfig
if PIOSIC_LEFT

config ZMK_KEYBOARD_NAME
	default "piosic"

config ZMK_SPLIT_ROLE_CENTRAL
	default y

endif

if PIOSIC_LEFT || PIOSIC_RIGHT

config ZMK_SPLIT
	default y

endif

if ZMK_DISPLAY

config I2C
	default y

config SSD1306
	default y

endif
```

## Kconfig.shield
```kconfig
config PIOSIC_LEFT
	def_bool $(shields_list_contains,piosic_left)

config PIOSIC_RIGHT
	def_bool $(shields_list_contains,piosic_right)
```
